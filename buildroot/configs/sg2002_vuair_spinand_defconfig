## buildroot/configs/sg2002_vuair_spinand_defconfig
```kconfig
BR2_arm=y

BR2_cortex_a53=y
BR2_ARM_EABIHF=y
BR2_ARM_FPU_FP_ARMV8=y
BR2_TOOLCHAIN_EXTERNAL=y

BR2_TOOLCHAIN_EXTERNAL=y
BR2_TOOLCHAIN_EXTERNAL_ARM_ARM=y
BR2_TOOLCHAIN_EXTERNAL_DOWNLOAD=y
BR2_TOOLCHAIN_EXTERNAL_GDB_SERVER_COPY=y
BR2_OPTIMIZE_2=y

BR2_CCACHE=y
BR2_REPRODUCIBLE=y
BR2_PER_PACKAGE_DIRECTORIES=y


BR2_TARGET_GENERIC_HOSTNAME="vuair"


BR2_TARGET_GENERIC_ISSUE="Welcome to Vu Air OS"


BR2_TARGET_GENERIC_ROOT_PASSWD=" "


BR2_ROOTFS_OVERLAY="$(TOPDIR)/board/cvitek/SG200X/overlay"
BR2_PACKAGE_BUSYBOX_CONFIG_FRAGMENT_FILES="$(TOPDIR)/board/cvitek/SG200X/busybox-extra.config"


BR2_PACKAGE_DUO_PINMUX=y


BR2_PACKAGE_SPIDEV_TEST=y


BR2_PACKAGE_STRACE=y


BR2_PACKAGE_E2FSPROGS=y


BR2_PACKAGE_E2FSPROGS_RESIZE2FS=y


BR2_PACKAGE_MTD=y


BR2_PACKAGE_EVTEST=y


BR2_PACKAGE_OPENSSL=y


BR2_PACKAGE_FREETYPE=y


BR2_PACKAGE_EXPAT=y


BR2_PACKAGE_JSON_C=y


BR2_PACKAGE_LIBXSLT=y


BR2_PACKAGE_LIBNL=y


BR2_PACKAGE_LIBFFI=y


BR2_PACKAGE_DHCPCD=y


BR2_PACKAGE_DNSMASQ=y


BR2_PACKAGE_DROPBEAR=y


BR2_PACKAGE_ETHTOOL=y


BR2_PACKAGE_IPERF3=y


BR2_PACKAGE_NTP=y


BR2_PACKAGE_NTP_NTPDATE=y


BR2_PACKAGE_NTP_NTPTIME=y


BR2_PACKAGE_HTOP=y


BR2_PACKAGE_KMOD=y


BR2_PACKAGE_UTIL_LINUX_UUIDD=y


BR2_TARGET_ROOTFS_SQUASHFS=y


BR2_TARGET_ROOTFS_SQUASHFS4_XZ=y


# BR2_TARGET_ROOTFS_TAR is not set


BR2_PACKAGE_HOST_E2FSPROGS=y


BR2_PACKAGE_HOST_GENIMAGE=y
```
